

#include <dt-bindings/board/am335x-bbw-bbb-base.h>
#include "am335x-peripheral-i2c1.dtsi"



&am33xx_pinmux {
	i2c1_pins: pinmux_i2c1{
		pinctrl-single,pins = <
			0x10C (PIN_INPUT_PULLUP | MUX_MODE3)
			0x110 (PIN_INPUT_PULLUP | MUX_MODE3)
		>;
	};
};

&i2c1 {
	pinctrl-0 = <&i2c1_pins>;
	clock-frequency = <400000>;
};
